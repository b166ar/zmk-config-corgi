//#include "hold_tap.dtsi"

morph_minus_plus: morph_minus_plus {
  compatible = "zmk,behavior-mod-morph";
  label = "MORPH_MINUS_PLUS";
  #binding-cells = <0>;
  bindings = <&kp MINUS>, <&kp PLUS>;
  mods = <(MOD_LSFT|MOD_RSFT)>;
};

morph_comma_underscore: morph_comma_underscore {
  compatible = "zmk,behavior-mod-morph";
  label = "MORPH_COMMA_UNDERSCORE";
  #binding-cells = <0>;
  bindings = <&kp COMMA>, <&kp UNDERSCORE>;
  mods = <(MOD_LSFT|MOD_RSFT)>;
};
